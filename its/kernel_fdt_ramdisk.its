## its/kernel_fdt_ramdisk.its
```
/dts-v1/;

/ {
	description = "Simple image with single Linux kernel and FDT blob";

	images {
		kernel@1 {
			description = "alientek Linux kernel";
			data = /incbin/("kernel/zImage");
			type = "kernel";
			arch = "arm";
			os = "linux";
			load = <0x84000000>;
			entry = <0x84000000>;
			compression = "none";
			hash@1 {
				algo = "sha1";
			};
		};

		ramdisk@1 {
			description = "alientek ramdisk";
			data = /incbin/("ramdisk/ramdisk.gz");
			type = "ramdisk";
			arch = "arm";
			os = "linux";
			load = <0x90000000>;
			entry = <0x90000000>;
			compression = "gzip";
			hash@1 {
				algo = "sha1";
			};
		};

		fdt@1 {
			description = "Flattened Device Tree blob";
			data = /incbin/("dtb/imx6ull-alientek-emmc.dtb");
			type = "flat_dt";
			arch = "arm";
			compression = "none";
			hash@1 {
				algo = "sha1";
			};
		};
	};

	configurations {
		default = "conf@1";
		conf@1 {
			description = "Boot Linux kernel with FDT blob";
			kernel = "kernel@1";
			ramdisk = "ramdisk@1";
			fdt = "fdt@1";
		};
	};
};
```

## its/kernel_rf_fdt.its
```
/dts-v1/;

/ {
	description = "Simple image with single Linux kernel and FDT blob";

	images {
		kernel@1 {
			description = "alientek Linux kernel";
			data = /incbin/("kernel/zImage");
			type = "kernel";
			arch = "arm";
			os = "linux";
                        load = <0x82000000>;
                        entry = <0x82000000>;
			compression = "none";
			hash@1 {
				algo = "sha1";
			};
		};

		fdt@1 {
			description = "Flattened Device Tree blob";
			data = /incbin/("dtb/imx6ull-alientek-emmc.dtb");
			type = "flat_dt";
			arch = "arm";
			compression = "none";
			hash@1 {
				algo = "sha1";
			};
		};

		rootfs@1 {
			description = "Flattened Device Tree blob";
			data = /incbin/("./rootfs/rootfs.imx");
			type = "rootfs";
			arch = "arm";
			compression = "none";
			hash@1 {
				algo = "sha1";
			};
		}
	};

	configurations {
		default = "conf@1";
		conf@1 {
			description = "Boot Linux kernel with FDT blob";
			kernel = "kernel@1";
			fdt = "fdt@1";
		};
	};
};
```
